## drivers/sensor/adxl343/Kconfig
```kconfig
config ADXL343
	bool "ADXL343 3-axis accelerometer Driver Sensor"
	default n
	depends on I2C
	help
	  Enable driver for the ADXL343 3-axis accelerometer Driver Sensor.
```

## dts/bindings/sensor/adi,adxl343.yaml
```yaml
description: Analog Devices ADXL343 3-axis accelerometer driver sensor

compatible: "adi,adxl343"

include: ["i2c-device.yaml", "sensor-device.yaml"]

properties:
  reg:
    required: true
    description: device address on i2c bus
```
